## drivers/input/touchscreen/ili9881x/Kconfig
```kconfig
# SPDX-License-Identifier: GPL-2.0
#
# ILI9881X Touchscreen driver
#

config TOUCHSCREEN_ILI9881X
	bool "ILI9881X touchscreen support"
	depends on INPUT && TOUCHSCREEN
	default y
	help
	  Say Y here if you have a touchscreen based on the
	  Ilitek ILI9881X controller.
```
